/*  SkaarhojSmartSwitch Arduino library for the BI8 board from SKAARHOJ.com
    Copyright (C) 2012 Kasper Skårhøj    <kasperskaarhoj@gmail.com> 
	Copyright (C) 2012 Filip Sandborg-Olsen   <filipsandborg@me.com>

    This program is free software: you can redistribute it and/or modify
    it under the terms of the GNU General Public License as published by
    the Free Software Foundation, either version 3 of the License, or
    (at your option) any later version.

    This program is distributed in the hope that it will be useful,
    but WITHOUT ANY WARRANTY; without even the implied warranty of
    MERCHANTABILITY or FITNESS FOR A PARTICULAR PURPOSE.  See the
    GNU General Public License for more details.

    You should have received a copy of the GNU General Public License
    along with this program.  If not, see <http://www.gnu.org/licenses/>.
*/
#include "SkaarhojSmartSwitch.h"

static uint8_t new_font[] PROGMEM = {
	0x08, // Width
	0x08, // Height
	0x20, // First char
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	0x00,
	0x00
};
static uint8_t _Font8x5[] PROGMEM = {
	0x06, // Width
	0x08, // Height
	0x20, // First char
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	0x00,0x04,0x1e,0x1f,0x1e,0x04,   
};

SkaarhojSmartSwitch::SkaarhojSmartSwitch(){}	// Empty constructor.

void SkaarhojSmartSwitch::begin(int address) {
	begin(address, 5, 6);	// Default pins on Arduino non-Mega. On Mega we normally use 48 & 49 (Clock and Data)
}
void SkaarhojSmartSwitch::begin(int address, const uint8_t clockPin, const uint8_t dataPin) {
	// NOTE: Wire.h should definitely be initialized at this point! (Wire.begin())
	
	_boardAddress = (address & B111);	// 0-3

	// Initializing:
	_buttonStatus = 0;
	_buttonStatusLastUp = 0;
	_buttonStatusLastDown = 0;

	_buttonMode = 0;

	_clockPin = clockPin;
	_dataPin = dataPin;

	pinMode(_clockPin, OUTPUT);
  	pinMode(_dataPin, OUTPUT);
	
	// Create object for reading button presses
	MCP23017 buttonMux;
	_buttonMux = buttonMux;
	_buttonMux.begin((int)(_boardAddress));

	_buttonMux.internalPullupMask(65535);	// Set pull-ups
	_buttonMux.inputOutputMask(65535-255);	// Set up input and output pins
    _buttonMux.inputPolarityMask(65535);	// Reverse polarity for inputs.

		// Pix maps for building screen content:
	_pixMap[0] = (uint8_t *) calloc(256,1);
	_pixMap[1] = (uint8_t *) calloc(256,1);
	_pixMap[2] = (uint8_t *) calloc(256,1);
	_pixMap[3] = (uint8_t *) calloc(256,1);
}

void SkaarhojSmartSwitch::setDefaultColor(uint8_t color) {
//	_defaultColor = color;
}

void SkaarhojSmartSwitch::setButtonColorsToDefault() {
//	setButtonColor(_defaultColor, B1111);
}

/**
 * red, green, blue: 0-3
 */
void SkaarhojSmartSwitch::setButtonColor(uint8_t red, uint8_t green, uint8_t blue, uint8_t buttons) {
	_writeCommand(0x40, (red & B11)<<6 | (green & B11)<<4 | (blue & B11)<<2 | B11, buttons);
}

/**
 * brightness: 0-7
 */
void SkaarhojSmartSwitch::setButtonBrightness(uint8_t brightness, uint8_t buttons) {
	_writeCommand(0x41, (brightness<<5) | B11111, buttons);	// 3 MSB
}

/**
 *  Returns true if a button 1-8 is has just been released
 */
bool SkaarhojSmartSwitch::buttonUp(int buttonNumber) {	
	if (_validButtonNumber(buttonNumber))	{
		_readButtonStatus();

		uint8_t mask = (B1 << (buttonNumber-1));
		uint8_t buttonChange = (_buttonStatusLastUp ^ _buttonStatus) & mask;
		_buttonStatusLastUp ^= buttonChange;

		return (buttonChange & ~_buttonStatus) ? true : false;
	} else return false;
}

/**
 *  Returns true if a button 1-8 is has just been pushed down
 */
bool SkaarhojSmartSwitch::buttonDown(int buttonNumber) {
	if (_validButtonNumber(buttonNumber))	{
		_readButtonStatus();

		uint8_t mask = (B1 << (buttonNumber-1));
		uint8_t buttonChange = (_buttonStatusLastDown ^ _buttonStatus) & mask;
		_buttonStatusLastDown ^= buttonChange;

		return (buttonChange & _buttonStatus) ? true : false;
	} else return false;
}

/**
 *  Returns true if a button 1-8 is currently pressed
 */
bool SkaarhojSmartSwitch::buttonIsPressed(int buttonNumber) {
	if (_validButtonNumber(buttonNumber))	{
		_readButtonStatus();
		return (SkaarhojSmartSwitch::buttonIsPressedAll() >> (buttonNumber-1)) ? true : false;
	} else return false;
}

/**
 *  Returns a byte where each bit indicates if a button 1-8 (bits 0-7) has been released since last check
 */
uint8_t SkaarhojSmartSwitch::buttonUpAll() {
	_readButtonStatus();
	
	uint8_t buttonChange = _buttonStatusLastUp ^ _buttonStatus;
	_buttonStatusLastUp = _buttonStatus;

	return buttonChange & ~_buttonStatus;
}

/**
 *  Returns a byte where each bit indicates if a button 1-8 (bits 0-7) has been pressed since last check
 */
uint8_t SkaarhojSmartSwitch::buttonDownAll() {
	_readButtonStatus();
	
	uint8_t buttonChange = _buttonStatusLastDown ^ _buttonStatus;
	_buttonStatusLastDown = _buttonStatus;
	
	return buttonChange & _buttonStatus;
}

/**
 *  Returns a byte where each bit indicates if a button 1-8 (bits 0-7) is currently pressed
 */
uint8_t SkaarhojSmartSwitch::buttonIsPressedAll() {
	_readButtonStatus();
	
	return _buttonStatus;
}

/**
 *  
 */
bool SkaarhojSmartSwitch::isButtonIn(int buttonNumber, uint8_t allButtonsState)	{
	if (_validButtonNumber(buttonNumber))	{
		return (allButtonsState & (B1 << (buttonNumber-1))) ? true : false;
	}
	return false;
}


uint8_t SkaarhojSmartSwitch::getButtonModes() {
	return _buttonMode;
}
void SkaarhojSmartSwitch::setButtonModes(uint8_t buttonMode) {
	_buttonMode = buttonMode;
}



void SkaarhojSmartSwitch::clearPixmap(int buttons) {
  for(int i=0; i < 8; i++) {
    if(buttons >> i & 1) {
      memset(_pixMap[i], 0x00, 256);
    }
  }
}
void SkaarhojSmartSwitch::drawRectangle(int x, int y, int width, int height, int buttons, int color, int border) {
	for(int i = x; i < x+width; i++) {
		for(int j = y; j < (y+height); j++) {
			if(i <= SCREEN_WIDTH && j <= SCREEN_HEIGHT) {
				if(border == 0 || i - x < border || i - x >= width - border || j - y < border || j - y >= height - border) {
					drawPixel(i,j,color,buttons);
				} else {
					drawPixel(i,j,!color, buttons);
				}
			}
		}
	}
}
void SkaarhojSmartSwitch::drawSquare(int x, int y, int len, int buttons) {
  drawRectangle(x,y,len,round((float)len/PIXEL_ASPECT), buttons, 1, 0);
}
void SkaarhojSmartSwitch::drawCircle(int x, int y, int radius, int buttons) {
    if(x+radius <= SCREEN_WIDTH && y+radius/PIXEL_ASPECT <= SCREEN_HEIGHT) {
    for(int i = x-radius; i < x+radius; i++) {
      for(int j = y-radius; j < y+radius; j++) {
        if(sqrt(sq(i-x)+sq((j-y) * PIXEL_ASPECT)) < radius) {
          drawPixel(i,j,1,buttons);
        }
      }
    }
  }
}
void SkaarhojSmartSwitch::drawLine(int start_x, int start_y, int end_x, int end_y, int buttons) {
  // http://en.wikipedia.org/wiki/Bresenham%27s_line_algorithm
  int cur_x = start_x;
  int cur_y = start_y;
  int dx, dy, ix, iy, err, e2;
  
  dx = abs(end_x - cur_x);
  dy = abs(end_y - cur_y);
  if(cur_x < end_x) {
    ix = 1;
  } else {
    ix = -1;
  }
  
  if(cur_y < end_y) {
    iy = 1;
  } else {
    iy = -1;
  }
  err = dx - dy;

  while (1) {
    drawPixel(cur_x, cur_y, 1, buttons);
    if(cur_x == end_x && cur_y == end_y) {
      break;
    }
    e2 = err*2;
    if(e2 > -dy) {
      err = err - dy;
      cur_x = cur_x + ix;
    }
    if(e2 < dx) {
      err = err + dx;
      cur_y = cur_y + iy;
    }
  }
}
void SkaarhojSmartSwitch::updateScreen(int buttons) {
  for(int i=0; i<8; i++) {
    if(buttons >> i & 1) {
      _writeEnableButtons(1<<i);
      shiftOut(_dataPin, _clockPin, MSBFIRST, 0x55);
      for(int seg = 0; seg <= 255; seg++) {
        shiftOut(_dataPin, _clockPin, MSBFIRST, _pixMap[i][seg]);
      }
    }
    _writeEnableButtons(0);
  } 
}

/**
 * Clear the screen of the button(s)
 */
void SkaarhojSmartSwitch::clearScreen(int buttons) {
  _writeEnableButtons(buttons);
  shiftOut(_dataPin, _clockPin, MSBFIRST, 0x55);
  for(int i=0;i<=255;i++){
    shiftOut(_dataPin, _clockPin, MSBFIRST, 0x00);
  }
  _writeEnableButtons(0);
}

void SkaarhojSmartSwitch::drawString(char* string, int buttons) {		// ????  Obsolete?
  int y=0;
  for(int i=0; i<strlen(string); i++) {
    if (i%10 == 0 && i !=0) {
      y++;
    }
    drawChar(i%10,y,string[i], buttons, _Font8x5, PIXEL_BLACK);
  }
}

/**
 * Writing text to the button(s) on a specific line
 */
void SkaarhojSmartSwitch::writeText(uint8_t buttons, char* textString, uint8_t lineNumber, int options) {
	uint8_t* font = _Font8x5;

	uint8_t width = pgm_read_byte(font);
	uint8_t height = pgm_read_byte(font + 1);

	uint8_t x = 0;
	uint8_t y = height * lineNumber;

	if(options & TEXT_CENTER) {
			x = (SCREEN_WIDTH - strlen(textString) * width)/2;
	}
	if(options & TEXT_RIGHT) {
			x = (SCREEN_WIDTH - strlen(textString) * width);
	}

	writeTextXY(buttons, textString, x, y, options);
}

/**
 * Writing text to the button(s) in specific XY location
 */
void SkaarhojSmartSwitch::writeTextXY(uint8_t buttons, char* textString, int x, int y, int options) {
	uint8_t* font = _Font8x5;

	uint8_t width = pgm_read_byte(font);
	uint8_t height = pgm_read_byte(font + 1);

	if (options & TEXT_BACKGROUND) {
		drawRectangle(x-1, y-1, width * strlen(textString) + 2, height + 2, buttons, (options & TEXT_REVERSE?1:0), 0);
	}

	for(int i=0; i<strlen(textString); i++) {
	drawChar(x + i*width,y,textString[i], buttons, font, options & TEXT_REVERSE);
	}
}

// inline should include this code where it is references at compile time, thus
// saving function calls..
inline void SkaarhojSmartSwitch::drawPixel(int x, int y, int val, int buttons) {
   for(int i = 0; i < 8; i++) {
     if(buttons >> i & 1 && (7-x/8) + 8*y <= 0xFF) {
     	if(val == 0) {
     		_pixMap[i][(7-x/8) + 8*y] &= ~(1 << x%8);
     	} else if(val == 1) {
       		_pixMap[i][(7-x/8) + 8*y] |= 1 << x%8;
       	}
     }
   }
}

/**
 * Drawing image
 * X-Y has origin in upper left corner and positive axes towards right/down
 * BUG: SmartSwitch.drawImage(BUTTON1, 0, -2, IMAGE_CENTER, movielogo);  // This line crashes the Arduino because of "-2". If "0" in the Y-coordinate, it doesn't. Probably there is a memory problem here!
 */
void SkaarhojSmartSwitch::drawImage(uint8_t buttons, int x, int y, int options, uint8_t* image) {
	uint8_t width = pgm_read_byte(image);
	uint8_t height = pgm_read_byte(image + 1);


	if(options & IMAGE_CENTER) {
		x = (SCREEN_WIDTH - width)/2;
	}

	int numpix = width * height;

	int row, col, j, b;
	uint8_t temp;
	int t = (numpix / (width * 8)) * width;
	int r = (numpix % (width*8)) / width;
	int total = (numpix - (numpix % (width*8)))/8 + width;
	for (b=2; b < total; b++) {
		temp = pgm_read_byte(image + b);
		col = (b-2) % width;
		row = ((b-2)/width)*8;
		for(j=0; j<((b-2)>=t?r:8); j++) {
			drawPixel(col+x,row+j+y,(temp & (1<<j)) >> j,buttons);
		}
	}
}

void SkaarhojSmartSwitch::drawChar(int x, int y, char c, int buttons, uint8_t* font, uint8_t reverse) {
  uint8_t width = pgm_read_byte(font);
  uint8_t height = pgm_read_byte(font + 1);
  uint8_t first_char = pgm_read_byte(font + 2);
  uint8_t last_char = pgm_read_byte(font + 3);
  uint8_t orientation = pgm_read_byte(font + 4);

  if(c > last_char) {
  	c = 0x20; // Substitute unsupported chars with whitespaces
  }
  c -= first_char;
  for(int i = 0; i < width; i++) {
    for(int ii = 0; ii < height; ii++) {
      //pixMap[(ii + y*8)*8 + (7-x)] |= (((Font8x5[c][i] & (1 << ii)) >> ii) << i) >> 1;
    	if(orientation == 0x00) {
    		uint8_t value = (pgm_read_byte(font + 5 + c*width + i)  & (1 << ii)) >> ii;
      		drawPixel(x + i,y + ii, (value?(reverse?0:1):-1), buttons);
  		} else {
  			uint8_t value = (pgm_read_byte(font + 5 + c*height + ii)  & (1 << (width-i))) >> (width-i);
  			drawPixel(x+ i,y + ii, (value?(reverse?0:1):-1), buttons);
  		}
    }
  }
}
void SkaarhojSmartSwitch::drawHorisontalLine(int y, int buttons) {
  drawLine(0,y,63,y, buttons);
}
void SkaarhojSmartSwitch::drawVerticalLine(int x, int buttons) {
  drawLine(x,0,x,31, buttons);
}




// Private methods:
void SkaarhojSmartSwitch::_readButtonStatus() {	// Reads button status from MCP23017 chip.
	word buttonStatus = _buttonMux.digitalWordRead();
	_buttonStatus = buttonStatus >> 8 & B1111;
}
bool SkaarhojSmartSwitch::_validButtonNumber(int buttonNumber)	{	// Checks if a button number is valid (1-4)
	return (buttonNumber>=1 && buttonNumber <= 4);
}
bool SkaarhojSmartSwitch::_validColorNumber(int colorNumber)	{	// Checks if a color number is valid (1-8)
	return (colorNumber>=0 && colorNumber <= 9);
}
bool SkaarhojSmartSwitch::_validPercentage(int percentage)	{	// Checks if a value is within 0-100
	return (percentage>=0 && percentage <= 100);
}

/**
 * Writing command to switch:
 */
int SkaarhojSmartSwitch::_writeCommand(int address, int value, uint8_t buttons) {
    //ground latchPin and hold low for as long as you are transmitting
  	_writeEnableButtons(buttons);

    shiftOut(_dataPin, _clockPin, MSBFIRST, address);   
    shiftOut(_dataPin, _clockPin, MSBFIRST, value);   
    //return the latch pin high to signal chip that it 
    //no longer needs to listen for information
  	_writeEnableButtons(0);
}
void SkaarhojSmartSwitch::_writeEnableButtons(uint8_t buttons)	{	// TODO: Make private, change how "states" work.
	_buttonMux.digitalWordWrite(255-buttons);
}

