/* -LICENSE-START-
 ** Copyright (c) 2016 Blackmagic Design
 **
 ** Permission is hereby granted, free of charge, to any person or organization
 ** obtaining a copy of the software and accompanying documentation covered by
 ** this license (the "Software") to use, reproduce, display, distribute,
 ** execute, and transmit the Software, and to prepare derivative works of the
 ** Software, and to permit third-parties to whom the Software is furnished to
 ** do so, all subject to the following:
 **
 ** The copyright notices in the Software and this entire statement, including
 ** the above license grant, this restriction and the following disclaimer,
 ** must be included in all copies of the Software, in whole or in part, and
 ** all derivative works of the Software, unless such copies or derivative
 ** works are solely in the form of machine-executable object code generated by
 ** a source language processor.
 **
 ** THE SOFTWARE IS PROVIDED "AS IS", WITHOUT WARRANTY OF ANY KIND, EXPRESS OR
 ** IMPLIED, INCLUDING BUT NOT LIMITED TO THE WARRANTIES OF MERCHANTABILITY,
 ** FITNESS FOR A PARTICULAR PURPOSE, TITLE AND NON-INFRINGEMENT. IN NO EVENT
 ** SHALL THE COPYRIGHT HOLDERS OR ANYONE DISTRIBUTING THE SOFTWARE BE LIABLE
 ** FOR ANY DAMAGES OR OTHER LIABILITY, WHETHER IN CONTRACT, TORT OR OTHERWISE,
 ** ARISING FROM, OUT OF OR IN CONNECTION WITH THE SOFTWARE OR THE USE OR OTHER
 ** DEALINGS IN THE SOFTWARE.
 ** -LICENSE-END-
 */

#pragma once

#include <Arduino.h>
#include <Wire.h>
#include <stdint.h>

namespace BMD {
template <typename T> class I2CPhysical : public T {
public:
  // Inherits from T
  virtual void begin(int wireAddress);
  virtual uint32_t regRead32(uint16_t address) const;
  virtual void regWrite32(uint16_t address, uint32_t value) const;
  virtual uint16_t regRead16(uint16_t address) const;
  virtual void regWrite16(uint16_t address, uint16_t value) const;
  virtual uint8_t regRead8(uint16_t address) const;
  virtual void regWrite8(uint16_t address, uint8_t value) const;
  virtual void regRead(uint16_t address, uint8_t values[], int length) const;
  virtual void regWrite(uint16_t address, const uint8_t values[], int length) const;

private:
  int m_wireAddress;
};

template <typename T> void I2CPhysical<T>::begin(int wireAddress) {
  m_wireAddress = wireAddress;
  Wire.begin();

  T::begin();
}

template <typename T> uint32_t I2CPhysical<T>::regRead32(uint16_t address) const {
  uint8_t regBytes[4];

  Wire.beginTransmission(m_wireAddress);
  Wire.write((uint8_t)(address & 0xFF));
  Wire.write((uint8_t)(address >> 8));
  Wire.endTransmission();

  Wire.requestFrom(m_wireAddress, 4);
  regBytes[0] = Wire.read();
  regBytes[1] = Wire.read();
  regBytes[2] = Wire.read();
  regBytes[3] = Wire.read();

  return ((uint32_t)regBytes[3] << 24) | ((uint32_t)regBytes[2] << 16) | ((uint32_t)regBytes[1] << 8) | regBytes[0];
}

template <typename T> void I2CPhysical<T>::regWrite32(uint16_t address, uint32_t value) const {
  Wire.beginTransmission(m_wireAddress);
  Wire.write((uint8_t)(address & 0xFF));
  Wire.write((uint8_t)(address >> 8));
  Wire.write((uint8_t)(value & 0xFF));
  Wire.write((uint8_t)(value >> 8));
  Wire.write((uint8_t)(value >> 16));
  Wire.write((uint8_t)(value >> 24));
  Wire.endTransmission();
}

template <typename T> uint16_t I2CPhysical<T>::regRead16(uint16_t address) const {
  uint8_t regBytes[2];

  Wire.beginTransmission(m_wireAddress);
  Wire.write((uint8_t)(address & 0xFF));
  Wire.write((uint8_t)(address >> 8));
  Wire.endTransmission();

  Wire.requestFrom(m_wireAddress, 2);
  regBytes[0] = Wire.read();
  regBytes[1] = Wire.read();

  return ((uint16_t)regBytes[1] << 8) | regBytes[0];
}

template <typename T> void I2CPhysical<T>::regWrite16(uint16_t address, uint16_t value) const {
  Wire.beginTransmission(m_wireAddress);
  Wire.write((uint8_t)(address & 0xFF));
  Wire.write((uint8_t)(address >> 8));
  Wire.write((uint8_t)(value & 0xFF));
  Wire.write((uint8_t)(value >> 8));
  Wire.endTransmission();
}

template <typename T> uint8_t I2CPhysical<T>::regRead8(uint16_t address) const {
  Wire.beginTransmission(m_wireAddress);
  Wire.write((uint8_t)(address & 0xFF));
  Wire.write((uint8_t)(address >> 8));
  Wire.endTransmission();

  Wire.requestFrom(m_wireAddress, 1);
  return Wire.read();
}

template <typename T> void I2CPhysical<T>::regWrite8(uint16_t address, uint8_t value) const {
  Wire.beginTransmission(m_wireAddress);
  Wire.write((uint8_t)(address & 0xFF));
  Wire.write((uint8_t)(address >> 8));
  Wire.write(value);
  Wire.endTransmission();
}

template <typename T> void I2CPhysical<T>::regRead(uint16_t address, uint8_t values[], int length) const {
  // EDIT 18/9/2017: Takes the buffer size from Wire.h . This allows a custom hardware platform to have sufficient receive performance
  // The Wire library only supports receiving small chunks of data at a time
  for (int position = 0; position < length; position += BUFFER_LENGTH - 2) {
    int readLength = min(length - position, BUFFER_LENGTH - 2);

    Wire.beginTransmission(m_wireAddress);
    Wire.write((uint8_t)(address & 0xFF));
    Wire.write((uint8_t)(address >> 8));
    Wire.endTransmission();

    Wire.requestFrom(m_wireAddress, readLength);
    for (int offset = 0; offset < readLength; offset++)
      values[position + offset] = Wire.read();
    Wire.endTransmission();

    address += readLength;
  }
}

template <typename T> void I2CPhysical<T>::regWrite(uint16_t address, const uint8_t values[], int length) const {
  // The Wire library only supports sending small chunks of data at a time
  for (int position = 0; position < length; position += 16) {
    int writeLength = min(length - position, 16);

    Wire.beginTransmission(m_wireAddress);
    Wire.write((uint8_t)(address & 0xFF));
    Wire.write((uint8_t)(address >> 8));

    for (int offset = 0; offset < writeLength; offset++)
      Wire.write(values[position + offset]);

    Wire.endTransmission();

    address += writeLength;
  }
}
}
