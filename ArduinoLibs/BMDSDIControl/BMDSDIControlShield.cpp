/* -LICENSE-START-
 ** Copyright (c) 2016 Blackmagic Design
 **
 ** Permission is hereby granted, free of charge, to any person or organization
 ** obtaining a copy of the software and accompanying documentation covered by
 ** this license (the "Software") to use, reproduce, display, distribute,
 ** execute, and transmit the Software, and to prepare derivative works of the
 ** Software, and to permit third-parties to whom the Software is furnished to
 ** do so, all subject to the following:
 ** 
 ** The copyright notices in the Software and this entire statement, including
 ** the above license grant, this restriction and the following disclaimer,
 ** must be included in all copies of the Software, in whole or in part, and
 ** all derivative works of the Software, unless such copies or derivative
 ** works are solely in the form of machine-executable object code generated by
 ** a source language processor.
 ** 
 ** THE SOFTWARE IS PROVIDED "AS IS", WITHOUT WARRANTY OF ANY KIND, EXPRESS OR
 ** IMPLIED, INCLUDING BUT NOT LIMITED TO THE WARRANTIES OF MERCHANTABILITY,
 ** FITNESS FOR A PARTICULAR PURPOSE, TITLE AND NON-INFRINGEMENT. IN NO EVENT
 ** SHALL THE COPYRIGHT HOLDERS OR ANYONE DISTRIBUTING THE SOFTWARE BE LIABLE
 ** FOR ANY DAMAGES OR OTHER LIABILITY, WHETHER IN CONTRACT, TORT OR OTHERWISE,
 ** ARISING FROM, OUT OF OR IN CONNECTION WITH THE SOFTWARE OR THE USE OR OTHER
 ** DEALINGS IN THE SOFTWARE.
 ** -LICENSE-END-
 */

#include <include/BMDSDIControlShield.h>
#include <include/BMDSDIControlShieldRegisters.h>

namespace BMD
{
	static const int kSDIControlShield_VersionMajor = 1;
	static const int kSDIControlShield_VersionMinor = 0;

	void SDIControlShield::begin() const
	{
		shieldInitialized = false;
		unsigned long startTime = millis();

		const uint32_t expectedIdentifier = ((uint32_t)'S' << 0 | (uint32_t)'D' << 8 | (uint32_t)'I' << 16 | (uint32_t)'C' << 24);
		
		// Wait for shield to become ready, the FPGA takes time to boot up
		while (regRead32(kRegIDENTIFIER) != expectedIdentifier)
		{
			if(millis() - startTime > 1000) {
				Serial.println("\nTimeout connecting to BMD SDI Shield");
				return;
			}
		}

		shieldInitialized = true;
	}

	Version SDIControlShield::getLibraryVersion() const
	{
		Version libraryVersion;

		libraryVersion.Major = kSDIControlShield_VersionMajor;
		libraryVersion.Minor = kSDIControlShield_VersionMinor;

		return libraryVersion;
	}

	Version SDIControlShield::getProtocolVersion() const
	{
		Version softwareVersion;

		uint16_t version = regRead16(kRegPVERSION);
		softwareVersion.Major = (version & kRegPVERSION_MAJOR_Mask) >> kRegPVERSION_MAJOR_Offset;
		softwareVersion.Minor = (version & kRegPVERSION_MINOR_Mask) >> kRegPVERSION_MINOR_Offset;

		return softwareVersion;
	}

	Version SDIControlShield::getFirmwareVersion() const
	{
		Version hardwareVersion;

		uint16_t version = regRead16(kRegFWVERSION);
		hardwareVersion.Major = (version & kRegFWVERSION_MAJOR_Mask) >> kRegFWVERSION_MAJOR_Offset;
		hardwareVersion.Minor = (version & kRegFWVERSION_MINOR_Mask) >> kRegFWVERSION_MINOR_Offset;

		return hardwareVersion;
	}

	void SDIControlShield::setOutputSignalOverride(bool enabled) const
	{
		byte regValue = regRead8(kRegCONTROL);

		if (enabled)
			regValue |=  kRegCONTROL_OOVERIDE_Mask;
		else
			regValue &= ~kRegCONTROL_OOVERIDE_Mask;

		regWrite8(kRegCONTROL, regValue);
	}

	bool SDIControlShield::getOutputSignalOverride() const
	{
		return regRead8(kRegCONTROL) & kRegCONTROL_OOVERIDE_Mask;
	}
}
