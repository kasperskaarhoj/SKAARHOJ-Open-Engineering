/*****************
 * Basis control for the SKAARHOJ C90 series devices. It's based on a C50 standard sketch, adding slider functionality.
 * This example is programmed for ATEM 1M/E versions
 *
 * This example also uses several custom libraries which you must install first. 
 * Search for "#include" in this file to find the libraries. Then download the libraries from http://skaarhoj.com/wiki/index.php/Libraries_for_Arduino
 *
 * Works with ethernet-enabled arduino devices (Arduino Ethernet or a model with Ethernet shield)
 * Make sure to configure IP and addresses first using the sketch "ConfigEthernetAddresses"
 * 
 * - kasper
 */



// Including libraries: 
#include <SPI.h>         // needed for Arduino versions later than 0018
#include <Ethernet.h>
#include "WebServer.h"  // For web interface
#include <EEPROM.h>      // For storing IP numbers

// Include ATEM library and make an instance:
#include <ATEM.h>
ATEM AtemSwitcher;

//#include <MemoryFree.h>

// Configure the IP addresses and MAC address with the sketch "ConfigEthernetAddresses":
static uint8_t default_ip[] = {     // IP for Configuration Mode (192.168.10.99)
  192, 168, 10, 99 };
uint8_t ip[4];        // Will hold the Arduino IP address
uint8_t atem_ip[4];  // Will hold the ATEM IP address
uint8_t mac[6];    // Will hold the Arduino Ethernet shield/board MAC address (loaded from EEPROM memory, set with ConfigEthernetAddresses example sketch)



// No-cost stream operator as described at 
// http://arduiniana.org/libraries/streaming/
template<class T>
inline Print &operator <<(Print &obj, T arg)
{  
  obj.print(arg); 
  return obj; 
}



// All related to library "SkaarhojBI8":
#include "Wire.h"
#include "MCP23017.h"
#include "PCA9685.h"
#include "SkaarhojBI8.h"
#include "SkaarhojUtils.h"


SkaarhojBI8 inputSelect;
SkaarhojBI8 cmdSelect;
SkaarhojUtils utils;







/*************************************************************
 *
 *
 *                     SMARTSWITCH FUNCTIONS
 *
 *
 **********************************************************/


#include <SkaarhojSmartSwitch.h>
SkaarhojSmartSwitch SmartSwitch;
uint8_t BUSselect = 0;  // Preview/Program by default

// AUX graphic:
static const uint8_t SSS_AUXgfx[] PROGMEM = {
  64, // width
  15, // height

  /* page 0 (lines 0-7) */
  0x0,0x0,0x80,0xc0,0xf0,0xfc,0xff,0xff,0x7f,0xf,0x1f,0xff,0xff,0xff,0xfc,0xf0,
  0xc0,0x0,0x0,0x0,0x0,0x0,0xff,0xff,0xff,0xff,0xff,0xff,0x0,0x0,0x0,0x0,
  0x0,0x0,0x0,0xff,0xff,0xff,0xff,0xff,0xff,0x0,0x0,0x0,0x0,0x1,0x7,0xf,
  0x1f,0x3f,0xff,0xff,0xfc,0xf8,0xf0,0xf0,0xf8,0xfe,0xff,0x7f,0x3f,0xf,0x7,0x3,

  /* page 1 (lines 8-15) */
  0x38,0x7e,0x7f,0x7f,0x7f,0x3f,0x1f,0x1f,0x1e,0x1e,0x1e,0x1e,0x1f,0x1f,0x3f,0x7f,
  0x7f,0x7f,0x7c,0x70,0x60,0x0,0xf,0x1f,0x1f,0x3f,0x3f,0x3f,0x78,0x70,0x70,0x70,
  0x70,0x70,0x78,0x7f,0x3f,0x3f,0x3f,0x1f,0xf,0x0,0x0,0x0,0x0,0x60,0x70,0x78,
  0x7c,0x7e,0x7f,0x3f,0x1f,0xf,0x7,0x7,0x7,0xf,0x1f,0x3f,0x7f,0x7e,0x78,0x70,

};

// PGM graphic:
static const uint8_t SSS_PGMgfx[] PROGMEM = {
  64, // width
  32, // height

  /* page 0 (lines 0-7) */
  0x0,0x0,0x0,0x0,0x0,0x0,0x0,0x0,0x0,0x0,0x0,0x0,0x0,0x0,0x0,0x0,
  0x0,0x0,0x0,0x0,0x0,0x0,0x0,0x0,0x0,0x0,0x0,0x0,0x0,0x0,0x0,0x0,
  0x0,0x0,0x0,0x0,0x0,0x0,0x0,0x0,0x0,0x0,0x0,0x0,0x0,0x0,0x0,0x0,
  0x0,0x0,0x0,0x0,0x0,0x0,0x0,0x0,0x0,0x0,0x0,0x0,0x0,0x0,0x0,0x0,

  /* page 1 (lines 8-15) */
  0xff,0xff,0xff,0xff,0xff,0xff,0xc7,0xc7,0xc7,0xc7,0xff,0xff,0xff,0xfe,0xfe,0x7c,
  0x0,0x0,0x0,0xf0,0xf8,0xfc,0xfe,0xfe,0xfe,0x1f,0xf,0x7,0x7,0x87,0x87,0x8f,
  0x9f,0x9f,0x8e,0x8e,0x8c,0x88,0x0,0x0,0x0,0x0,0xff,0xff,0xff,0xff,0xff,0x3f,
  0xff,0xff,0xfc,0xc0,0x0,0x0,0xf0,0xfe,0xff,0x7f,0x1f,0xff,0xff,0xff,0xff,0xff,

  /* page 2 (lines 16-23) */
  0x7f,0x7f,0x7f,0x7f,0x7f,0x7f,0x1,0x1,0x1,0x1,0x1,0x1,0x1,0x0,0x0,0x0,
  0x0,0x0,0x0,0x7,0xf,0x1f,0x3f,0x3f,0x3f,0x7c,0x78,0x70,0x70,0x73,0x73,0x73,
  0x73,0x3f,0x3f,0x3f,0x3f,0x1f,0x0,0x0,0x0,0x0,0x7f,0x7f,0x7f,0x7f,0x7f,0x0,
  0x1,0xf,0x7f,0x7f,0x7e,0x7f,0x7f,0x3f,0x3,0x0,0x0,0x7f,0x7f,0x7f,0x7f,0x7f,

  /* page 3 (lines 24-31) */
  0x0,0x0,0x0,0x0,0x0,0x0,0x0,0x0,0x0,0x0,0x0,0x0,0x0,0x0,0x0,0x0,
  0x0,0x0,0x0,0x0,0x0,0x0,0x0,0x0,0x0,0x0,0x0,0x0,0x0,0x0,0x0,0x0,
  0x0,0x0,0x0,0x0,0x0,0x0,0x0,0x0,0x0,0x0,0x0,0x0,0x0,0x0,0x0,0x0,
  0x0,0x0,0x0,0x0,0x0,0x0,0x0,0x0,0x0,0x0,0x0,0x0,0x0,0x0,0x0,0x0,

};


// PIP_L graphic:
static const uint8_t SSS_PIPLgfx[] PROGMEM = {
  64, // width
  32, // height

  /* page 0 (lines 0-7) */
  0x0,0x0,0x0,0x0,0x0,0x0,0x0,0x0,0x0,0xff,0xff,0xff,0xff,0xff,0xff,0xc7,
  0xc7,0xc7,0xc7,0xff,0xff,0xff,0xfe,0xfe,0x7c,0x0,0x0,0x0,0x0,0xff,0xff,0xff,
  0xff,0xff,0xff,0x0,0x0,0x0,0x0,0xff,0xff,0xff,0xff,0xff,0xff,0xc7,0xc7,0xc7,
  0xc7,0xff,0xff,0xff,0xfe,0xfe,0x7c,0x0,0x0,0x0,0x0,0x0,0x0,0x0,0x0,0x0,

  /* page 1 (lines 8-15) */
  0x0,0x0,0x0,0x0,0x0,0x0,0x0,0x0,0x0,0x7f,0x7f,0x7f,0x7f,0x7f,0x7f,0x1,
  0x1,0x1,0x1,0x1,0x1,0x1,0x0,0x0,0x0,0x0,0x0,0x0,0x0,0x7f,0x7f,0x7f,
  0x7f,0x7f,0x7f,0x0,0x0,0x0,0x0,0x7f,0x7f,0x7f,0x7f,0x7f,0x7f,0x1,0x1,0x1,
  0x1,0x1,0x1,0x1,0x0,0x0,0x0,0x0,0x0,0x0,0x0,0x0,0x0,0x0,0x0,0x0,

  /* page 2 (lines 16-23) */
  0x0,0x0,0x0,0x0,0xfc,0xfc,0xc,0xc,0xc,0xc,0xc,0xc,0xc,0xc,0xc,0xc,
  0xc,0xc,0xc,0xc,0xc,0xc,0xc,0xc,0xc,0xc,0xc,0xc,0xc,0xfc,0xfc,0x0,
  0x0,0x0,0x0,0x0,0x0,0x0,0x0,0x0,0x0,0x0,0x0,0x0,0x0,0x0,0x0,0x0,
  0x0,0x0,0x0,0x0,0x0,0x0,0x0,0x0,0x0,0x0,0x0,0x0,0x0,0x0,0x0,0x0,

  /* page 3 (lines 24-31) */
  0x0,0x0,0x0,0x0,0x3f,0x3f,0x30,0x30,0x30,0x30,0x30,0x30,0x30,0x30,0x30,0x30,
  0x30,0x30,0x30,0x30,0x30,0x30,0x30,0x30,0x30,0x30,0x30,0x30,0x30,0x3f,0x3f,0x0,
  0x0,0x0,0x0,0x0,0x0,0x0,0x0,0x0,0x0,0x0,0x0,0x0,0x0,0x0,0x0,0x0,
  0x0,0x0,0x0,0x0,0x0,0x0,0x0,0x0,0x0,0x0,0x0,0x0,0x0,0x0,0x0,0x0,  
};

// PIP_R graphic:
static const uint8_t SSS_PIPRgfx[] PROGMEM = {
  64, // width
  32, // height

  /* page 0 (lines 0-7) */
  0x0,0x0,0x0,0x0,0x0,0x0,0x0,0x0,0x0,0xff,0xff,0xff,0xff,0xff,0xff,0xc7,
  0xc7,0xc7,0xc7,0xff,0xff,0xff,0xfe,0xfe,0x7c,0x0,0x0,0x0,0x0,0xff,0xff,0xff,
  0xff,0xff,0xff,0x0,0x0,0x0,0x0,0xff,0xff,0xff,0xff,0xff,0xff,0xc7,0xc7,0xc7,
  0xc7,0xff,0xff,0xff,0xfe,0xfe,0x7c,0x0,0x0,0x0,0x0,0x0,0x0,0x0,0x0,0x0,

  /* page 1 (lines 8-15) */
  0x0,0x0,0x0,0x0,0x0,0x0,0x0,0x0,0x0,0x7f,0x7f,0x7f,0x7f,0x7f,0x7f,0x1,
  0x1,0x1,0x1,0x1,0x1,0x1,0x0,0x0,0x0,0x0,0x0,0x0,0x0,0x7f,0x7f,0x7f,
  0x7f,0x7f,0x7f,0x0,0x0,0x0,0x0,0x7f,0x7f,0x7f,0x7f,0x7f,0x7f,0x1,0x1,0x1,
  0x1,0x1,0x1,0x1,0x0,0x0,0x0,0x0,0x0,0x0,0x0,0x0,0x0,0x0,0x0,0x0,

  /* page 2 (lines 16-23) */
  0x0,0x0,0x0,0x0,0x0,0x0,0x0,0x0,0x0,0x0,0x0,0x0,0x0,0x0,0x0,0x0,
  0x0,0x0,0x0,0x0,0x0,0x0,0x0,0x0,0x0,0x0,0x0,0x0,0x0,0x0,0x0,0x0,
  0x0,0xfc,0xfc,0xc,0xc,0xc,0xc,0xc,0xc,0xc,0xc,0xc,0xc,0xc,0xc,0xc,
  0xc,0xc,0xc,0xc,0xc,0xc,0xc,0xc,0xc,0xc,0xfc,0xfc,0x0,0x0,0x0,0x0,

  /* page 3 (lines 24-31) */
  0x0,0x0,0x0,0x0,0x0,0x0,0x0,0x0,0x0,0x0,0x0,0x0,0x0,0x0,0x0,0x0,
  0x0,0x0,0x0,0x0,0x0,0x0,0x0,0x0,0x0,0x0,0x0,0x0,0x0,0x0,0x0,0x0,
  0x0,0x3f,0x3f,0x30,0x30,0x30,0x30,0x30,0x30,0x30,0x30,0x30,0x30,0x30,0x30,0x30,
  0x30,0x30,0x30,0x30,0x30,0x30,0x30,0x30,0x30,0x30,0x3f,0x3f,0x0,0x0,0x0,0x0,

};









/*************************************************************
 *
 *
 *                     Webserver
 *
 *
 **********************************************************/

#define PREFIX ""
WebServer webserver(PREFIX, 80);

void logoCmd(WebServer &server, WebServer::ConnectionType type, char *url_tail, bool tail_complete)
{
  /* this data was taken from a PNG file that was converted to a C data structure
   * by running it through the directfb-csource application. 
   * (Alternatively by PHPSH script "HeaderGraphicsWebInterfaceInUnitsPNG8.phpsh")
   */
  P(logoData) = {
    0x89, 0x50, 0x4e, 0x47, 0x0d, 0x0a, 0x1a, 0x0a, 0x00, 0x00, 
    0x00, 0x0d, 0x49, 0x48, 0x44, 0x52, 0x00, 0x00, 0x02, 0xa2, 
    0x00, 0x00, 0x00, 0x2b, 0x08, 0x03, 0x00, 0x00, 0x00, 0x94, 
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    0x4e, 0x44, 0xae, 0x42, 0x60, 0x82        };

  if (type == WebServer::POST)
  {
    // ignore POST data
    server.httpFail();
    return;
  }

  /* for a GET or HEAD, send the standard "it's all OK headers" but identify our data as a PNG file */
  server.httpSuccess("image/png");

  /* we don't output the body for a HEAD request */
  if (type == WebServer::GET)
  {
    server.writeP(logoData, sizeof(logoData));
  }
}

// commands are functions that get called by the webserver framework
// they can read any posted data from client, and they output to server
void webDefaultView(WebServer &server, WebServer::ConnectionType type)
{
  P(htmlHead) =
    "<html>"
    "<head>"
    "<title>SKAARHOJ Device Configuration</title>"
    "<style type=\"text/css\">"
    "BODY { font-family: sans-serif }"
    "H1 { font-size: 14pt; }"
    "P  { font-size: 10pt; }"
    "</style>"
    "</head>"
    "<body>"
    "<img src='logo.png'><br/>";

  int i;
  server.httpSuccess();
  server.printP(htmlHead);

  server << "<div style='width:660px; margin-left:10px;'><form action='" PREFIX "/form' method='post'>";

  // C100 Panel IP:
  server << "<h1>SKAARHOJ Device IP Address:</h1><p>";
  for (i = 0; i <= 3; ++i)
  {
    server << "<input type='text' name='IP" << i << "' value='" << EEPROM.read(i+2) << "' id='IP" << i << "' size='4'>";
    if (i<3)  server << '.';
  }
  server << "<hr/>";

  // ATEM Switcher Panel IP:
  server << "<h1>ATEM Switcher IP Address:</h1><p>";
  for (i = 0; i <= 3; ++i)
  {
    server << "<input type='text' name='ATEM_IP" << i << "' value='" << EEPROM.read(i+2+4) << "' id='ATEM_IP" << i << "' size='4'>";
    if (i<3)  server << '.';
  }
  server << "<hr/>";

  // End form and page:
  server << "<input type='submit' value='Submit'/></form></div>";
  server << "<br><i>(Reset / Pull the power after submitting the form successfully)</i>";
  server << "</body></html>";
}

void formCmd(WebServer &server, WebServer::ConnectionType type, char *url_tail, bool tail_complete)
{
  if (type == WebServer::POST)
  {
    bool repeat;
    char name[16], value[16];
    do
    {
      repeat = server.readPOSTparam(name, 16, value, 16);
      String Name = String(name);

      // C100 Panel IP:
      if (Name.startsWith("IP"))  {
        int addr = strtoul(name + 2, NULL, 10);
        int val = strtoul(value, NULL, 10);
        if (addr>=0 && addr <=3)  {
          EEPROM.write(addr+2, val);  // IP address stored in bytes 0-3
        }
      }

      // ATEM Switcher Panel IP:
      if (Name.startsWith("ATEM_IP"))  {
        int addr = strtoul(name + 7, NULL, 10);
        int val = strtoul(value, NULL, 10);
        if (addr>=0 && addr <=3)  {
          EEPROM.write(addr+2+4, val);  // IP address stored in bytes 4-7
        }
      }

    } 
    while (repeat);

    server.httpSeeOther(PREFIX "/form");
  }
  else
    webDefaultView(server, type);
}
void defaultCmd(WebServer &server, WebServer::ConnectionType type, char *url_tail, bool tail_complete)
{
  webDefaultView(server, type);  
}





























/*************************************************************
 *
 *
 *                     MAIN PROGRAM CODE AHEAD
 *
 *
 **********************************************************/
bool isConfigMode;  // If set, the system will run the Web Configurator, not the normal program
void setup() { 

  // Start the Ethernet, Serial (debugging) and UDP:
  Serial.begin(9600);
  Serial << F("\n- - - - - - - -\nSerial Started\n");  





  // *********************************
  // Start up BI8 boards and I2C bus:
  // *********************************
  // Always initialize Wire before setting up the SkaarhojBI8 class!
  Wire.begin(); 

  // Set up the SkaarhojBI8 boards:
  inputSelect.begin(0,false);
  cmdSelect.begin(1,false);



  // *********************************
  // Mode of Operation (Normal / Configuration)
  // *********************************
  // Determine web config mode
  // This is done by:
  // -  either flipping a switch connecting A1 to GND
  // -  Holding the CUT button during start up.
  pinMode(A1,INPUT_PULLUP);
  delay(100);
  isConfigMode = cmdSelect.buttonIsPressed(1) || (analogRead(A1) > 100) ? true : false;




  // *********************************
  // EEPROM memory:
  // *********************************
  // EEPROM MEMORY:
  // 0-1:  Initialization check
  // 2-5:  Arduino IP
  // 6-9:  ATEM IP
  // 10-16: Arduino MAC address (6+1 byte)
  // 17: Reboot counter


  // Setting the Arduino IP address:
  // *********************************
  // Setting up IP addresses, starting Ethernet
  // *********************************
  if (isConfigMode)  {
    // Setting the default ip address for configuration mode:
    ip[0] = default_ip[0];
    ip[1] = default_ip[1];
    ip[2] = default_ip[2];
    ip[3] = default_ip[3];
  } 
  else {
    ip[0] = EEPROM.read(2);
    ip[1] = EEPROM.read(3);
    ip[2] = EEPROM.read(4);
    ip[3] = EEPROM.read(5);
  }

  // Setting the ATEM IP address:
  atem_ip[0] = EEPROM.read(6);
  atem_ip[1] = EEPROM.read(7);
  atem_ip[2] = EEPROM.read(8);
  atem_ip[3] = EEPROM.read(9);

  Serial << F("SKAARHOJ Device IP Address: ") << ip[0] << "." << ip[1] << "." << ip[2] << "." << ip[3] << "\n";
  Serial << F("ATEM Switcher IP Address: ") << atem_ip[0] << "." << atem_ip[1] << "." << atem_ip[2] << "." << atem_ip[3] << "\n";

  // Setting MAC address:
  mac[0] = EEPROM.read(10);
  mac[1] = EEPROM.read(11);
  mac[2] = EEPROM.read(12);
  mac[3] = EEPROM.read(13);
  mac[4] = EEPROM.read(14);
  mac[5] = EEPROM.read(15);
  char buffer[18];
  sprintf(buffer, "%02X:%02X:%02X:%02X:%02X:%02X", mac[0], mac[1], mac[2], mac[3], mac[4], mac[5]);
  Serial << F("SKAARHOJ Device MAC address: ") << buffer << F(" - Checksum: ")
    << ((mac[0]+mac[1]+mac[2]+mac[3]+mac[4]+mac[5]) & 0xFF) << "\n";
  if ((uint8_t)EEPROM.read(16)!=((mac[0]+mac[1]+mac[2]+mac[3]+mac[4]+mac[5]) & 0xFF))  {
    Serial << F("MAC address not found in EEPROM memory!\n") <<
      F("Please load example sketch ConfigEthernetAddresses to set it.\n") <<
      F("The MAC address is found on the backside of your Ethernet Shield/Board\n (STOP)");
    while(true);
  }


  // Update the boot counter:
  EEPROM.write(17,EEPROM.read(17)+1);


  Ethernet.begin(mac, ip);






  // *********************************
  // Final Setup based on mode
  // *********************************
  if (isConfigMode)  {

    // Red by default:
    inputSelect.setDefaultColor(2);
    cmdSelect.setDefaultColor(2); 
    inputSelect.setButtonColorsToDefault();
    cmdSelect.setButtonColorsToDefault();

    webserver.begin();
    webserver.setDefaultCommand(&defaultCmd);
    webserver.addCommand("form", &formCmd);
    webserver.addCommand("logo.png", &logoCmd);
  } 
  else {

    inputSelect.setDefaultColor(0);  // Off by default
    cmdSelect.setDefaultColor(0);  // Off by default

    inputSelect.testSequence();
    cmdSelect.testSequence();

    // Switches on address 4 + SDI on pins 5+6:  
    SmartSwitch.begin(4);
    SmartSwitch.setButtonBrightness(7, BUTTON_ALL);
    SmartSwitch.setButtonColor(2,2,2,BUTTON_ALL);
    SmartSwitch.clearScreen(BUTTON_ALL);

    // Initializing the slider:
    utils.uniDirectionalSlider_init();

    // Initialize a connection to the switcher:
    AtemSwitcher.begin(IPAddress(atem_ip[0],atem_ip[1],atem_ip[2],atem_ip[3]), 56417);
    //  AtemSwitcher.serialOutput(true);  // Remove or comment out this line for production code. Serial output may decrease performance!
    AtemSwitcher.connect();
  }
}

// These variables are used to track state, for instance when the VGA+PIP button has been pushed.
bool preVGA_active = false;
bool preVGA_UpstreamkeyerStatus = false;
int preVGA_programInput = 0;
bool AtemOnline = false;


void loop() {

  if (isConfigMode)  {
    webserver.processConnection();
  } 
  else {
    // Check for packets, respond to them etc. Keeping the connection alive!
    AtemSwitcher.runLoop();

    // If connection is gone, try to reconnect:
    if (AtemSwitcher.isConnectionTimedOut())  {
      if (AtemOnline)  {
        AtemOnline = false;

        Serial.println("Turning off buttons light");
        inputSelect.setDefaultColor(0);  // Off by default
        cmdSelect.setDefaultColor(0);  // Off by default
        inputSelect.setButtonColorsToDefault();
        cmdSelect.setButtonColorsToDefault();
      }

      Serial.println("Connection to ATEM Switcher has timed out - reconnecting!");
      AtemSwitcher.connect();
    }

    // If the switcher has been initialized, check for button presses as reflect status of switcher in button lights:
    if (AtemSwitcher.hasInitialized())  {
      if (!AtemOnline)  {
        AtemOnline = true;
        Serial.println("Turning on buttons");

        inputSelect.setDefaultColor(5);  // Dimmed by default
        cmdSelect.setDefaultColor(5);  // Dimmed by default
        inputSelect.setButtonColorsToDefault();
        cmdSelect.setButtonColorsToDefault();
      }


      setButtonColors();
      commandDispatch();
      slider();
      smartSwitches();

    }
  }
}






/*************************
 * Set button colors
 *************************/
void setButtonColors()  {
  // Setting colors of input select buttons:
  for (uint8_t i=1;i<=8;i++)  {
    uint8_t idx = i>4 ? i-4 : i+4;  // Mirroring because of buttons on PCB

    if (BUSselect==0)  {  // Normal: PROGRAM
      if (AtemSwitcher.getProgramTally(i))  {
        inputSelect.setButtonColor(idx, 2);
      } 
      else if (AtemSwitcher.getPreviewTally(i))  {
        inputSelect.setButtonColor(idx, 3);
      } 
      else {
        inputSelect.setButtonColor(idx, 5);   
      }
    } 
    else if (BUSselect<=3)  {  // 1-3: AUX bus:
      if (i==8?(AtemSwitcher.getAuxState(BUSselect)==16):(AtemSwitcher.getAuxState(BUSselect)==i))  {
        inputSelect.setButtonColor(idx, 4);   
      } 
      else {
        inputSelect.setButtonColor(idx, 5);   
      }
    }
  }

  // Setting colors of the command buttons:
  cmdSelect.setButtonColor(3, AtemSwitcher.getTransitionPosition()>0 ? 4 : 5);     // Auto button
  cmdSelect.setButtonColor(8, preVGA_active ? 4 : 5);     // VGA+PIP button
  cmdSelect.setButtonColor(4, AtemSwitcher.getUpstreamKeyerStatus(1) ? 4 : 5);     // PIP button
  cmdSelect.setButtonColor(7, AtemSwitcher.getDownstreamKeyerStatus(1) ? 4 : 5);    // DSK1 button
  if (!cmdSelect.buttonIsPressed(1))  {
    cmdSelect.setButtonColor(1, 5);   // de-highlight CUT button
  }
}




/*************************
 * Commands handling
 *************************/
void commandDispatch()  {

  // Sending commands, bus input selection:
  uint8_t busSelection = inputSelect.buttonDownAll();
  if (BUSselect==0)  {
    for (uint8_t i=1;i<=8;i++)  {
      uint8_t idx = i>4 ? i-4 : i+4;  // Mirroring because of buttons on PCB
      if (inputSelect.isButtonIn(i, busSelection))  { 
        AtemSwitcher.changeProgramInput(idx); 
      }
    }
  } 
  else if (BUSselect<=3)  {
    for (uint8_t i=1;i<=8;i++)  {
      uint8_t idx = i>4 ? i-4 : i+4;  // Mirroring because of buttons on PCB
      if (inputSelect.isButtonIn(i, busSelection))  { 
        AtemSwitcher.changeAuxState(BUSselect, idx==8?16:idx); 
      }  // When selecting AUX bus, input 8 is mapped to PROGRAM instead
    }
  } 
  else if (BUSselect==10 || BUSselect==11)  {
    for (uint8_t i=1;i<=8;i++)  {
      uint8_t idx = i>4 ? i-4 : i+4;  // Mirroring because of buttons on PCB
      if (inputSelect.isButtonIn(i, busSelection))  { 
        AtemSwitcher.mediaPlayerSelectSource(BUSselect-9, false, idx); 
      }
    }
  } 



  // Reading buttons from the Command BI8 board:
  uint8_t cmdSelection = cmdSelect.buttonDownAll();
  if (cmdSelection & (B1 << 0))  { 
    commandCut();
  }
  if (cmdSelection & (B1 << 2))  { 
    commandAuto();
  }
  if (cmdSelection & (B1 << 3))  {
    commandPIP();
  }
  if (cmdSelection & (B1 << 6))  { 
    commandDSK1();
  }
  if (cmdSelection & (B1 << 7))  {
    commandPIPVGA();
  }  
}


/*************************
 * Commands handling
 *************************/
void slider()  {
  // "T-bar" slider:
  if (utils.uniDirectionalSlider_hasMoved())  {
    AtemSwitcher.changeTransitionPosition(utils.uniDirectionalSlider_position());
    AtemSwitcher.delay(20);
    if (utils.uniDirectionalSlider_isAtEnd())  {
      AtemSwitcher.changeTransitionPositionDone();
      AtemSwitcher.delay(5);  
    }
  }
}






uint8_t prevBUSselect = 255;
uint8_t pipMode = 0;
uint8_t prevPipMode = 0;
void smartSwitches()  {
  word buttons = SmartSwitch.buttonUpAll();

  // SmartSwitch 1 action:
  uint8_t j = 0;
  if(buttons & (1 << j)) {
    BUSselect++;
    if (BUSselect>3)  {
      BUSselect=0;
    }
  }
  // SmartSwitch 1 display content:
  if (prevBUSselect!=BUSselect)  {
    prevBUSselect =  BUSselect;
    switch(BUSselect)  {
    case 1:
      SmartSwitch.clearPixmap(1<<j);
      SmartSwitch.drawImage(BUTTON1, 0, 0, IMAGE_LEFT, SSS_AUXgfx);        
      SmartSwitch.writeTextXY(BUTTON1, "1", 32-10, 24, TEXT_BACKGROUND | TEXT_REVERSE);
      SmartSwitch.writeTextXY(BUTTON1, "2", 32, 24, TEXT_BACKGROUND);
      SmartSwitch.writeTextXY(BUTTON1, "3", 32+10, 24, TEXT_BACKGROUND);
      SmartSwitch.setButtonColor(2,0,0, 1<<j);
      SmartSwitch.updateScreen(1<<j);
      break;
    case 2:
      SmartSwitch.clearPixmap(1<<j);
      SmartSwitch.drawImage(BUTTON1, 0, 0, IMAGE_LEFT, SSS_AUXgfx);        
      SmartSwitch.writeTextXY(BUTTON1, "1", 32-10, 24, TEXT_BACKGROUND);
      SmartSwitch.writeTextXY(BUTTON1, "2", 32, 24, TEXT_BACKGROUND | TEXT_REVERSE);
      SmartSwitch.writeTextXY(BUTTON1, "3", 32+10, 24, TEXT_BACKGROUND);
      SmartSwitch.setButtonColor(2,0,0, 1<<j);
      SmartSwitch.updateScreen(1<<j);
      break;
    case 3:
      SmartSwitch.clearPixmap(1<<j);
      SmartSwitch.drawImage(BUTTON1, 0, 0, IMAGE_LEFT, SSS_AUXgfx);        
      SmartSwitch.writeTextXY(BUTTON1, "1", 32-10, 24, TEXT_BACKGROUND);
      SmartSwitch.writeTextXY(BUTTON1, "2", 32, 24, TEXT_BACKGROUND);
      SmartSwitch.writeTextXY(BUTTON1, "3", 32+10, 24, TEXT_BACKGROUND | TEXT_REVERSE);
      SmartSwitch.setButtonColor(2,0,0, 1<<j);
      SmartSwitch.updateScreen(1<<j);
      break;
    case 10:
      SmartSwitch.clearPixmap(1<<j);
      SmartSwitch.writeText(BUTTON1, "MEDIA 1", 3, TEXT_CENTER | TEXT_BACKGROUND | TEXT_REVERSE);
      SmartSwitch.setButtonColor(2,2,0, 1<<j);
      SmartSwitch.updateScreen(1<<j);
      break;
    case 11:
      SmartSwitch.clearPixmap(1<<j);
      SmartSwitch.writeText(BUTTON1, "MEDIA 2", 3, TEXT_CENTER | TEXT_BACKGROUND | TEXT_REVERSE);
      SmartSwitch.setButtonColor(2,2,0, 1<<j);
      SmartSwitch.updateScreen(1<<j);
      break;
    case 0:
      SmartSwitch.clearPixmap(1<<j);
      SmartSwitch.drawImage(BUTTON1, 0, -3, IMAGE_LEFT, SSS_PGMgfx);        
      SmartSwitch.writeText(BUTTON1, "PROGRAM", 3, TEXT_CENTER | TEXT_BACKGROUND | TEXT_REVERSE);
      SmartSwitch.setButtonColor(2,2,2, 1<<j);
      SmartSwitch.updateScreen(1<<j);
      break;
    default:
      SmartSwitch.clearPixmap(1<<j);
      SmartSwitch.writeText(BUTTON1, "N/A", 3, TEXT_CENTER | TEXT_BACKGROUND | TEXT_REVERSE);
      SmartSwitch.setButtonColor(0,0,0, 1<<j);
      SmartSwitch.updateScreen(1<<j);
      break;
    }
  }

  // SmartSwitch 1 action:
  j = 1;
  if(buttons & (1 << j)) {
    pipMode++;
    if (pipMode>2)  {
      pipMode=1;
    }
    switch(pipMode)  {
    case 1:
      AtemSwitcher.changeDVESettingsTemp(-8500,-4500,300,300);
      break;
    case 2:
      AtemSwitcher.changeDVESettingsTemp(8500,-4500,300,300);
      break;
    }
  }
  // SmartSwitch 1 display content:
  if (prevPipMode!=pipMode)  {
    prevPipMode =  pipMode;
    switch(pipMode)  {
    case 1:
      SmartSwitch.clearPixmap(1<<j);
      SmartSwitch.drawImage(BUTTON2, 0, 0, IMAGE_LEFT, SSS_PIPLgfx);        
      SmartSwitch.setButtonColor(1,1,2, 1<<j);
      SmartSwitch.updateScreen(1<<j);
      break;
    case 2:
      SmartSwitch.clearPixmap(1<<j);
      SmartSwitch.drawImage(BUTTON2, 0, 0, IMAGE_LEFT, SSS_PIPRgfx);        
      SmartSwitch.setButtonColor(1,1,2, 1<<j);
      SmartSwitch.updateScreen(1<<j);
      break;
    default:
      SmartSwitch.clearPixmap(1<<j);
      SmartSwitch.writeText(BUTTON2, "N/A", 3, TEXT_CENTER | TEXT_BACKGROUND | TEXT_REVERSE);
      SmartSwitch.updateScreen(1<<j);
      SmartSwitch.setButtonColor(0,0,0, 1<<j);
      break;
    }
  }
}







