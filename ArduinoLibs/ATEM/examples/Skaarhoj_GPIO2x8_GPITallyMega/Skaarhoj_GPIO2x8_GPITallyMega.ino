/*****************
 * A GPI/Tally box for Blackmagic ATEM Switchers
 * Includes a web interface available on Arduino Megas.
 * 
 * This example REQUIRES the Skaarhoj GPIO2x8 shield for Arduino. That particular shield
 * is a general purpose GPIO board but with connectors and curcuitry compatible with
 * Blackmagic-Designs own GPI/Tally box.
 *
 * This example also uses a number of custom libraries which you must install first. 
 * Search for "#include" in this file to find the libraries. Then download the libraries from http://skaarhoj.com/wiki/index.php/Libraries_for_Arduino
 *
 * By default the example will reflect the Program tally state on the 8 camera inputs
 * The GPI inputs will set the corresponding input as Program
 * If you call the functions setTallyPreviewProgramOutputs() and checkGPI_setVarious() instead (see code)
 * you will see a demonstration of alternative configurations - how customized you can work with the ATEM Switcher
 *
 * Works with Ethernet enabled arduino devices (Arduino Ethernet or a model with Ethernet shield)
 * Make sure to configure IP and addresses! Look for "<= SETUP" in the code below!
 *
 * - kasper
 */


#include <SPI.h>         // needed for Arduino versions later than 0018
#include <Ethernet.h>
#include "WebServer.h"  // For web interface
#include <EEPROM.h>      // For storing IP numbers


static uint8_t default_ip[] = {     // IP for Configuration Mode (192.168.10.99)
  192, 168, 10, 99 };
uint8_t ip[4];        // Will hold the C200 IP address
uint8_t atem_ip[4];  // Will hold the ATEM IP address
uint8_t mac[6];    // Will hold the Arduino Ethernet shield/board MAC address (loaded from EEPROM memory, set with ConfigEthernetAddresses example sketch)



// No-cost stream operator as described at 
// http://arduiniana.org/libraries/streaming/
template<class T>
inline Print &operator <<(Print &obj, T arg)
{  
  obj.print(arg); 
  return obj; 
}



// Include ATEM library and make an instance:
#include <ATEM.h>

// Connect to an ATEM switcher on this address and using this local port:
// The port number is chosen randomly among high numbers.
ATEM AtemSwitcher;


// Related to SkaarhojGPIO2x8:
#include <Wire.h>
#include <MCP23017.h>
#include <SkaarhojGPIO2x8.h>

SkaarhojGPIO2x8 GPIOboard;






/*************************************************************
 *
 *
 *                     Webserver
 *
 *
 **********************************************************/




#define PREFIX ""
WebServer webserver(PREFIX, 80);

void logoCmd(WebServer &server, WebServer::ConnectionType type, char *url_tail, bool tail_complete)
{
  /* this data was taken from a PNG file that was converted to a C data structure
   * by running it through the directfb-csource application. 
   * (Alternatively by PHPSH script "HeaderGraphicsWebInterfaceInUnitsPNG8.phpsh")
   */
  P(logoData) = {
    0x89, 0x50, 0x4e, 0x47, 0x0d, 0x0a, 0x1a, 0x0a, 0x00, 0x00, 
    0x00, 0x0d, 0x49, 0x48, 0x44, 0x52, 0x00, 0x00, 0x02, 0xa2, 
    0x00, 0x00, 0x00, 0x2b, 0x08, 0x03, 0x00, 0x00, 0x00, 0x94, 
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    0x4e, 0x44, 0xae, 0x42, 0x60, 0x82            };

  if (type == WebServer::POST)
  {
    // ignore POST data
    server.httpFail();
    return;
  }

  /* for a GET or HEAD, send the standard "it's all OK headers" but identify our data as a PNG file */
  server.httpSuccess("image/png");

  /* we don't output the body for a HEAD request */
  if (type == WebServer::GET)
  {
    server.writeP(logoData, sizeof(logoData));
  }
}

// commands are functions that get called by the webserver framework
// they can read any posted data from client, and they output to server
void webDefaultView(WebServer &server, WebServer::ConnectionType type)
{
  P(htmlHead) =
    "<html>"
    "<head>"
    "<title>SKAARHOJ Device Configuration</title>"
    "<style type=\"text/css\">"
    "BODY { font-family: sans-serif }"
    "H1 { font-size: 14pt; }"
    "P  { font-size: 10pt; }"
    "</style>"
    "</head>"
    "<body>"
    "<img src='logo.png'><br/>";

  int i;
  server.httpSuccess();
  server.printP(htmlHead);

  server << "<div style='width:660px; margin-left:10px;'><form action='" PREFIX "/form' method='post'>";

  // Panel IP:
  server << "<h1>SKAARHOJ Device IP Address:</h1><p>";
  for (i = 0; i <= 3; ++i)
  {
    server << "<input type='text' name='IP" << i << "' value='" << EEPROM.read(i+2) << "' id='IP" << i << "' size='4'>";
    if (i<3)  server << '.';
  }
  server << "<hr/>";

  // ATEM Switcher Panel IP:
  server << "<h1>ATEM Switcher IP Address:</h1><p>";
  for (i = 0; i <= 3; ++i)
  {
    server << "<input type='text' name='ATEM_IP" << i << "' value='" << EEPROM.read(i+2+4) << "' id='ATEM_IP" << i << "' size='4'>";
    if (i<3)  server << '.';
  }
  server << "<hr/>";

  // End form and page:
  server << "<input type='submit' value='Submit'/></form></div>";
  server << "<br><i>(Reset / Pull the power after submitting the form successfully)</i>";
  server << "</body></html>";
}

void formCmd(WebServer &server, WebServer::ConnectionType type, char *url_tail, bool tail_complete)
{
  if (type == WebServer::POST)
  {
    bool repeat;
    char name[16], value[16];
    do
    {
      repeat = server.readPOSTparam(name, 16, value, 16);
      String Name = String(name);

      // C200 Panel IP:
      if (Name.startsWith("IP"))  {
        int addr = strtoul(name + 2, NULL, 10);
        int val = strtoul(value, NULL, 10);
        if (addr>=0 && addr <=3)  {
          EEPROM.write(addr+2, val);  // IP address stored in bytes 0-3
        }
      }

      // ATEM Switcher Panel IP:
      if (Name.startsWith("ATEM_IP"))  {
        int addr = strtoul(name + 7, NULL, 10);
        int val = strtoul(value, NULL, 10);
        if (addr>=0 && addr <=3)  {
          EEPROM.write(addr+2+4, val);  // IP address stored in bytes 4-7
        }
      }

    } 
    while (repeat);

    server.httpSeeOther(PREFIX "/form");
  }
  else
    webDefaultView(server, type);
}
void defaultCmd(WebServer &server, WebServer::ConnectionType type, char *url_tail, bool tail_complete)
{
  webDefaultView(server, type);  
}





























/*************************************************************
 *
 *
 *                     MAIN PROGRAM CODE AHEAD
 *
 *
 **********************************************************/



bool isConfigMode;  // If set, the system will run the Web Configurator, not the normal program

void setup() { 
  Serial.begin(9600);
  Serial << F("\n- - - - - - - -\nSerial Started\n");



  // *********************************
  // Mode of Operation (Normal / Configuration)
  // *********************************
  // Determine web config mode
  // This is done by:
  // -  either flipping a switch connecting A1 to GND
  // -  Holding the CUT button during start up.
  pinMode(A1,INPUT_PULLUP);
  delay(100);
  isConfigMode = (analogRead(A1) > 100) ? true : false;




  // *********************************
  // INITIALIZE EEPROM memory:
  // *********************************
  // Check if EEPROM has ever been initialized, if not, install default IP
  if (EEPROM.read(0) != 12 ||  EEPROM.read(1) != 232)  {  // Just randomly selected values which should be unlikely to be in EEPROM by default.
    // Set these random values so this initialization is only run once!
    EEPROM.write(0,12);
    EEPROM.write(1,232);

    // Set default IP address for Arduino/C100 panel (192.168.10.99)
    EEPROM.write(2,192);
    EEPROM.write(3,168);
    EEPROM.write(4,10);
    EEPROM.write(5,99);  // Just some value I chose, probably below DHCP range?

    // Set default IP address for ATEM Switcher (192.168.10.240):
    EEPROM.write(6,192);
    EEPROM.write(7,168);
    EEPROM.write(8,10);
    EEPROM.write(9,240);
  }


  // *********************************
  // Setting up IP addresses, starting Ethernet
  // *********************************
  if (isConfigMode)  {
    // Setting the default ip address for configuration mode:
    ip[0] = default_ip[0];
    ip[1] = default_ip[1];
    ip[2] = default_ip[2];
    ip[3] = default_ip[3];
  } 
  else {
    ip[0] = EEPROM.read(0+2);
    ip[1] = EEPROM.read(1+2);
    ip[2] = EEPROM.read(2+2);
    ip[3] = EEPROM.read(3+2);
  }

  // Setting the ATEM IP address:
  atem_ip[0] = EEPROM.read(0+2+4);
  atem_ip[1] = EEPROM.read(1+2+4);
  atem_ip[2] = EEPROM.read(2+2+4);
  atem_ip[3] = EEPROM.read(3+2+4);

  Serial << F("SKAARHOJ Device IP Address: ") << ip[0] << "." << ip[1] << "." << ip[2] << "." << ip[3] << "\n";
  Serial << F("ATEM Switcher IP Address: ") << atem_ip[0] << "." << atem_ip[1] << "." << atem_ip[2] << "." << atem_ip[3] << "\n";

  // Setting MAC address:
  mac[0] = EEPROM.read(10);
  mac[1] = EEPROM.read(11);
  mac[2] = EEPROM.read(12);
  mac[3] = EEPROM.read(13);
  mac[4] = EEPROM.read(14);
  mac[5] = EEPROM.read(15);
  char buffer[18];
  sprintf(buffer, "%02X:%02X:%02X:%02X:%02X:%02X", mac[0], mac[1], mac[2], mac[3], mac[4], mac[5]);
//  Serial << F("SKAARHOJ Device MAC address: ") << buffer << F(" - Checksum: ")
//    << ((mac[0]+mac[1]+mac[2]+mac[3]+mac[4]+mac[5]) & 0xFF);
  if ((uint8_t)EEPROM.read(16)!=((mac[0]+mac[1]+mac[2]+mac[3]+mac[4]+mac[5]) & 0xFF))  {
/*    Serial << F("MAC address not found in EEPROM memory!\n") <<
      F("Please load example sketch ConfigEthernetAddresses to set it.\n") <<
      F("The MAC address is found on the backside of your Ethernet Shield/Board\n (STOP)");
*/    while(true);
  }



  // Start the Ethernet, Serial (debugging) and UDP:
  Ethernet.begin(mac,ip);

  Wire.begin(); // Start the wire library for communication with the GPIO chip.

  GPIOboard.begin();

  // Set:
  for (int i=1; i<=8; i++)  {
    GPIOboard.setOutput(i,HIGH);
    delay(100); 
  }
  // Clear:
  for (int i=1; i<=8; i++)  {
    GPIOboard.setOutput(i,LOW);
    delay(100); 
  }


  // Sets the Bi-color LED to off = "no connection"
  digitalWrite(2,false);
  digitalWrite(3,false);
  pinMode(2, OUTPUT);
  pinMode(3, OUTPUT);


  // *********************************
  // Final Setup based on mode
  // *********************************
  if (isConfigMode)  {
    webserver.begin();
    webserver.setDefaultCommand(&defaultCmd);
    webserver.addCommand("form", &formCmd);
    webserver.addCommand("logo.png", &logoCmd);
  } 
  else {
    // Initialize a connection to the switcher:
    AtemSwitcher.begin(IPAddress(atem_ip[0], atem_ip[1], atem_ip[2], atem_ip[3]), 56417);    // <= SETUP!
    AtemSwitcher.serialOutput(true);
    AtemSwitcher.connect();

    // Set Bi-color LED orange - indicates "connecting...":
    digitalWrite(3,true);
    digitalWrite(2,true);
  }
}

bool AtemOnline = false;
void loop() {
  if (isConfigMode)  {
    webserver.processConnection();
    digitalWrite(3,(((unsigned long)millis()>>3) & B11000000) ? true : false);
  } 
  else {
    // Check for packets, respond to them etc. Keeping the connection alive!
    AtemSwitcher.runLoop();

    // If connection is gone anyway, try to reconnect:
    if (AtemSwitcher.isConnectionTimedOut())  {
      if (AtemOnline)  {
        AtemOnline = false;

        // Set Bi-color LED off = "no connection"
        digitalWrite(3,true);
        digitalWrite(2,false);
      }

      Serial.println("Connection to ATEM Switcher has timed out - reconnecting!");
      AtemSwitcher.connect();

      // Set Bi-color LED orange - indicates "connecting...":
      digitalWrite(3,true);
      digitalWrite(2,true);
    }  

    // If the switcher has been initialized, check for button presses as reflect status of switcher in button lights:
    if (AtemSwitcher.hasInitialized())  {
      if (!AtemOnline)  {
        AtemOnline = true;
        // Set Bi-color LED to red or green depending on mode:
        digitalWrite(3,false);
        digitalWrite(2,true);
      }

      // Selecting output mode: Let only ONE of the functions below be run - the others must be commented out:
      setTallyProgramOutputs();    // This will reflect inputs 1-8 Program tally on GPO 1-8
      //  setTallyPreviewProgramOutputs();    // This will reflect inputs 1-4 Program/Preview tally on GPO 1-8 (in pairs)


      checkGPI_setProgramBus();  // This will select the inputs 1-8 to be on the Program bus.
      //checkGPI_setVarious();  // This will call all sorts of switcher functions as a demonstration of how much crazy stuff can be done. See the function for more info.
    }
  }
}


void setTallyProgramOutputs()  {
  // Setting colors of input select buttons:
  for (uint8_t i=1;i<=8;i++)  {
    if (AtemSwitcher.getProgramTally(i))  {
      GPIOboard.setOutput(i,HIGH);
    }       
    else {
      GPIOboard.setOutput(i,LOW);
    }
  }
}

void setTallyPreviewProgramOutputs()  {
  // Setting colors of input select buttons:
  for (uint8_t i=1;i<=4;i++)  {
    if (AtemSwitcher.getProgramTally(i))  {
      GPIOboard.setOutput(i*2-1,HIGH);
    }       
    else {
      GPIOboard.setOutput(i*2-1,LOW);
    }

    if (AtemSwitcher.getPreviewTally(i))  {
      GPIOboard.setOutput(i*2,HIGH);
    }       
    else {
      GPIOboard.setOutput(i*2,LOW);
    }
  }
}

void checkGPI_setProgramBus()  {
  for(int i=1; i<=8; i++)  {
    if (GPIOboard.inputDown(i))  {
      AtemSwitcher.changeProgramInput(i);

      AtemSwitcher.delay(3);  // to catch any rebounce from the switch
      break;  // Only send one command at a time!
    }
  }
}

void checkGPI_setVarious()  {
  for(int i=1; i<=8; i++)  {
    if (GPIOboard.inputDown(i))  {

      switch(i){
      case 1:
        AtemSwitcher.doCut();  // Cut on GPI 1
        break; 
      case 2:
        AtemSwitcher.doAuto();   // Auto transition on GPI 2
        break; 
      case 3:
        AtemSwitcher.fadeToBlackActivate();   // Fade to black on GPI 3
        break; 
      case 4:
        AtemSwitcher.changeTransitionType(2); // Transition type "Wipe"  on GPI 4
        break; 
      case 5:
        AtemSwitcher.changeUpstreamKeyOn(1, AtemSwitcher.getUpstreamKeyerStatus(1)?false:true);   // Toggle Upstream keyer 1 on GPI 5
        break; 
      case 6:
        AtemSwitcher.changeAuxState(2, 16);  // Change AUX2 to Program on GPI 6
        break; 
      case 7:
        AtemSwitcher.changeColorValue(1, 2011, 246, 535);  // Set color value of Color generator 1 to a light blue plus set Color 1 on preview on GPI 7
        AtemSwitcher.delay(3);  // Allow command to go over ethernet and respond to reply of command before sending the next.
        AtemSwitcher.changePreviewInput(10);
        break; 
      case 8:
        AtemSwitcher.changeTransitionType(0);   // Change transition type to Mix on GPI 8
        break; 
      }

      AtemSwitcher.delay(10);  // to catch any rebounce from the switch
      break;  // Only send one command at a time!
    }
  }
}






