/*****************
 * A Tally box for Blackmagic ATEM Switchers
 * Includes a web interface available on Arduino Megas.
 *
 * This example REQUIRES the Skaarhoj GPIO1x16 shield for Arduino. That particular shield
 * is a general purpose tally board but with connectors and curcuitry compatible with
 * Blackmagic-Designs own Tally box.
 *
 * This example also uses a number of custom libraries which you must install first.
 * Search for "#include" in this file to find the libraries. Then download the libraries from http://skaarhoj.com/wiki/index.php/Libraries_for_Arduino
 *
 * By default the example will reflect the Program tally state on the 8-16 camera inputs
 *
 * Works with Ethernet enabled arduino devices (Arduino Ethernet or a model with Ethernet shield)
 * Make sure to configure IP and addresses! Look for "<= SETUP" in the code below!
 *
 * - kasper
 */

#include <SPI.h>         // needed for Arduino versions later than 0018
#include <Ethernet.h>
#include "WebServer.h"  // For web interface
#include <EEPROM.h>      // For storing IP numbers
#include <Streaming.h>

#include <SkaarhojPgmspace.h>
#include "SkaarhojTools.h"
SkaarhojTools sTools(1);

static uint8_t default_ip[] = {     // IP for Configuration Mode (192.168.10.99)
  192, 168, 10, 99
};
uint8_t ip[4];        // Will hold the C200 IP address
uint8_t atem_ip[4];  // Will hold the ATEM IP address
uint8_t mac[6];    // Will hold the Arduino Ethernet shield/board MAC address (loaded from EEPROM memory, set with ConfigEthernetAddresses example sketch)

#include <MemoryFree.h>

// Include ATEM library and make an instance:
#include <ATEMbase.h>
#include <ATEMext.h>

// Connect to an ATEM switcher on this address and using this local port:
// The port number is chosen randomly among high numbers.
ATEMext AtemSwitcher;


// Related to SkaarhojGPIO1x16:
#include <Wire.h>
#include <MCP23017.h>
#include <SkaarhojGPIO2x8.h>

SkaarhojGPIO2x8 GPIOboard;

int greenLED = 14;
int redLED = 13;
int blueLED = 15;

uint8_t numberOfTallyLights = 8;



/*************************************************************
 *
 *
 *                     Webserver
 *
 *
 **********************************************************/




#define PREFIX ""
WebServer webserver(PREFIX, 80);

void logoCmd(WebServer &server, WebServer::ConnectionType type, char *url_tail, bool tail_complete)
{
  /* this data was taken from a PNG file that was converted to a C data structure
   * by running it through the directfb-csource application.
   * (Alternatively by PHPSH script "HeaderGraphicsWebInterfaceInUnitsPNG8.phpsh")
   */
  P(logoData) = {
    0x89, 0x50, 0x4e, 0x47, 0x0d, 0x0a, 0x1a, 0x0a, 0x00, 0x00,
    0x00, 0x0d, 0x49, 0x48, 0x44, 0x52, 0x00, 0x00, 0x02, 0xa2,
    0x00, 0x00, 0x00, 0x2b, 0x08, 0x03, 0x00, 0x00, 0x00, 0x94,
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    0x4e, 0x44, 0xae, 0x42, 0x60, 0x82
  };

  if (type == WebServer::POST)
  {
    // ignore POST data
    server.httpFail();
    return;
  }

  /* for a GET or HEAD, send the standard "it's all OK headers" but identify our data as a PNG file */
  server.httpSuccess("image/png");

  /* we don't output the body for a HEAD request */
  if (type == WebServer::GET)
  {
    server.writeP(logoData, sizeof(logoData));
  }
}

// commands are functions that get called by the webserver framework
// they can read any posted data from client, and they output to server
void webDefaultView(WebServer &server, WebServer::ConnectionType type)
{
  P(htmlHead) =
    "<html>"
    "<head>"
    "<title>SKAARHOJ Device Configuration</title>"
    "<style type=\"text/css\">"
    "BODY { font-family: sans-serif }"
    "H1 { font-size: 14pt; }"
    "P  { font-size: 10pt; }"
    "</style>"
    "</head>"
    "<body>"
    "<img src='logo.png'><br/>";

  int i;
  server.httpSuccess();
  server.printP(htmlHead);

  server << F("<div style='width:660px; margin-left:10px;'><form action='") << PREFIX << F("/form' method='post'>");

  // Panel IP:
  server << F("<h1>SKAARHOJ Device IP Address:</h1><p>");
  for (i = 0; i <= 3; ++i)
  {
    server << F("<input type='text' name='IP") << i << F("' value='") << EEPROM.read(i + 2) << F("' id='IP") << i << F("' size='4'>");
    if (i < 3)  server << F(".");
  }
  server << F("<hr/>");

  // ATEM Switcher Panel IP:
  server << F("<h1>ATEM Switcher IP Address:</h1><p>");
  for (i = 0; i <= 3; ++i)
  {
    server << F("<input type='text' name='ATEM_IP") << i << F("' value='") << EEPROM.read(i + 2 + 4) << F("' id='ATEM_IP") << i << F("' size='4'>");
    if (i < 3)  server << F(".");
  }
  server << F("<hr/>");

  ////////////////////////////////////////////////////////

  server << F("<h1>Set tally sources:</h1><table border=0 cellspacing=3><tr>");
  for (i = 1; i <= numberOfTallyLights; i++) {
    server << F("<td></p>");
    server << F("<select name='GPO") << i << F(":'div style='width:78px;>");
    server << F("<option value='0'></option>");

    server << F("<option value='") << 0 << F("'") << (EEPROM.read(250 + i) == 0 ? F(" selected='selected'") : F("")) << F(">\t") << F("</option>");

    // Inputs 1-20
    for (uint8_t j = 1; j <= 20; j++)  {
      server << F("<option value='") << j << F("'") << (EEPROM.read(250 + i) == j ? F(" selected='selected'") : F("")) << F(">Cam ") << j << F("</option>");
    }

    // Media players
    //server << F("<option value='") << 21 << "'" << (EEPROM.read(250 + i) == 21 ? " selected='selected'" : "") << ">MediaPlayer1" << "</option>";
    //server << F("<option value='") << 22 << "'" << (EEPROM.read(250 + i) == 22 ? " selected='selected'" : "") << ">MediaPlayer2" << "</option>";

    server << F("</select></td>");
  }
  server << F("</tr></table><hr/>");


  ///////////////////////////////////////////////////

  // End form and page:
  server << F("<input type='submit' value='Submit'/></form></div>");
  server << F("<br><i>(Reset / Pull the power after submitting the form successfully)</i>");
  server << F("</body></html>");
}

void formCmd(WebServer &server, WebServer::ConnectionType type, char *url_tail, bool tail_complete)
{
  if (type == WebServer::POST)
  {
    bool repeat;
    char name[16], value[16];
    do
    {
      repeat = server.readPOSTparam(name, 16, value, 16);
      String Name = String(name);

      // C200 Panel IP:
      if (Name.startsWith("IP"))  {
        int addr = strtoul(name + 2, NULL, 10);
        int val = strtoul(value, NULL, 10);
        if (addr >= 0 && addr <= 3)  {
          EEPROM.write(addr + 2, val); // IP address stored in bytes 0-3
        }
      }

      // ATEM Switcher Panel IP:
      if (Name.startsWith("ATEM_IP"))  {
        int addr = strtoul(name + 7, NULL, 10);
        int val = strtoul(value, NULL, 10);
        if (addr >= 0 && addr <= 3)  {
          EEPROM.write(addr + 2 + 4, val); // IP address stored in bytes 4-7
        }
      }

      if (Name.startsWith("GPO"))  {
        int inputNum = strtoul(name + 3, NULL, 10);
        int val = strtoul(value, NULL, 10);
        if (inputNum >= 1 && inputNum <= 8)  {
          EEPROM.write(250 + inputNum, val);
        }
      }

    }
    while (repeat);

    server.httpSeeOther(PREFIX "/form");
  }
  else
    webDefaultView(server, type);
}
void defaultCmd(WebServer &server, WebServer::ConnectionType type, char *url_tail, bool tail_complete)
{
  webDefaultView(server, type);
}





























/*************************************************************
 *
 *
 *                     MAIN PROGRAM CODE AHEAD
 *
 *
 **********************************************************/



bool isConfigMode;  // If set, the system will run the Web Configurator, not the normal program
uint16_t tallySrc[8];

void setup() {
  Serial.begin(115200);
  Serial << F("\n- - - - - - - -\nSerial Started\n");



  // *********************************
  // Mode of Operation (Normal / Configuration)
  // *********************************
  // Determine web config mode

  digitalWrite(redLED, 1);   // To prevent brief light in LEDs upon boot
  digitalWrite(blueLED, 1);   // To prevent brief light in LEDs upon boot
  digitalWrite(greenLED, 1);   // To prevent brief light in LEDs upon boot
  pinMode(redLED, OUTPUT);    // Red Status LED, active low
  pinMode(blueLED, OUTPUT);    // Blue Status LED, active low
  pinMode(greenLED, OUTPUT);    // Green Status LED, active low

  delay(100);


  // Check CFG input:
  Serial << F("\nCheck if config button is held down after power-up/reset...\n");
  if (!digitalRead(18)) {   // Config mode, light up status LED in red and stop.
    digitalWrite(redLED, 1);   // Red
    digitalWrite(greenLED, 1);   // Green
    digitalWrite(blueLED, 0);   // Blue
    Serial << F(" => Config Mode ON: Status LED is blue.\n");
    isConfigMode = true;
  } else {
    Serial << F(" => Config Mode OFF\n");
  }
  delay(500);




  // *********************************
  // INITIALIZE EEPROM memory:
  // *********************************
  // Check if EEPROM has ever been initialized, if not, install default IP
  if (EEPROM.read(0) != 12 ||  EEPROM.read(1) != 232)  {  // Just randomly selected values which should be unlikely to be in EEPROM by default.
    // Set these random values so this initialization is only run once!
    EEPROM.write(0, 12);
    EEPROM.write(1, 232);

    // Set default IP address for Arduino/C100 panel (192.168.10.99)
    EEPROM.write(2, 192);
    EEPROM.write(3, 168);
    EEPROM.write(4, 10);
    EEPROM.write(5, 99); // Just some value I chose, probably below DHCP range?

    // Set default IP address for ATEM Switcher (192.168.10.240):
    EEPROM.write(6, 192);
    EEPROM.write(7, 168);
    EEPROM.write(8, 10);
    EEPROM.write(9, 240);
  }


  // *********************************
  // Setting up IP addresses, starting Ethernet
  // *********************************
  if (isConfigMode)  {
    // Setting the default ip address for configuration mode:
    ip[0] = default_ip[0];
    ip[1] = default_ip[1];
    ip[2] = default_ip[2];
    ip[3] = default_ip[3];
  }
  else {
    ip[0] = EEPROM.read(0 + 2);
    ip[1] = EEPROM.read(1 + 2);
    ip[2] = EEPROM.read(2 + 2);
    ip[3] = EEPROM.read(3 + 2);
  }

  // Setting the ATEM IP address:
  atem_ip[0] = EEPROM.read(0 + 2 + 4);
  atem_ip[1] = EEPROM.read(1 + 2 + 4);
  atem_ip[2] = EEPROM.read(2 + 2 + 4);
  atem_ip[3] = EEPROM.read(3 + 2 + 4);


  Serial << F("SKAARHOJ Device IP Address: ") << ip[0] << "." << ip[1] << "." << ip[2] << "." << ip[3] << "\n";
  Serial << F("ATEM Switcher IP Address: ") << atem_ip[0] << "." << atem_ip[1] << "." << atem_ip[2] << "." << atem_ip[3] << "\n";

  // Setting MAC address:
  mac[0] = EEPROM.read(10);
  mac[1] = EEPROM.read(11);
  mac[2] = EEPROM.read(12);
  mac[3] = EEPROM.read(13);
  mac[4] = EEPROM.read(14);
  mac[5] = EEPROM.read(15);
  char buffer[18];
  sprintf(buffer, "%02X:%02X:%02X:%02X:%02X:%02X", mac[0], mac[1], mac[2], mac[3], mac[4], mac[5]);
  //  Serial << F("SKAARHOJ Device MAC address: ") << buffer << F(" - Checksum: ")
  //    << ((mac[0]+mac[1]+mac[2]+mac[3]+mac[4]+mac[5]) & 0xFF);
  if ((uint8_t)EEPROM.read(16) != ((mac[0] + mac[1] + mac[2] + mac[3] + mac[4] + mac[5]) & 0xFF))  {
    /*    Serial << F("MAC address not found in EEPROM memory!\n") <<
     F("Please load example sketch ConfigEthernetAddresses to set it.\n") <<
     F("The MAC address is found on the backside of your Ethernet Shield/Board\n (STOP)");
     */    while (true);

  }

  // Update the boot counter:
  EEPROM.write(17, EEPROM.read(17) + 1);


  // Start the Ethernet, Serial (debugging) and UDP:
  Ethernet.begin(mac, ip);

  Wire.begin(); // Start the wire library for communication with the GPIO chip.

  GPIOboard.begin(0, 1);

  // Set:
  for (int i = 1; i <= numberOfTallyLights*2; i++)  {
    GPIOboard.setOutput(i, HIGH);
    delay(200);
    GPIOboard.setOutput(i, LOW);
    //delay(100);
  }


 // Sets the Bi-color LED to off = "no connection"
  pinMode(greenLED, OUTPUT);
  pinMode(redLED, OUTPUT);
  pinMode(blueLED, OUTPUT);
  digitalWrite(greenLED, HIGH);
  digitalWrite(redLED, HIGH);
  digitalWrite(blueLED, HIGH);


  // *********************************
  // Final Setup based on mode
  // *********************************
  if (isConfigMode)  {
    webserver.begin();
    webserver.setDefaultCommand(&defaultCmd);
    webserver.addCommand("form", &formCmd);
    webserver.addCommand("logo.png", &logoCmd);
    Serial.println("Config Mode");
  }
  else {
    for (uint8_t i = 1; i <= numberOfTallyLights; i++) {
      //GPO1[i - 1] = EEPROM.read(240 + i);
      tallySrc[i - 1] = EEPROM.read(250 + i);
//      if (tallySrc[i - 1] == 21) {
//        tallySrc[i - 1] = 3010;
//      }
//      if (tallySrc[i - 1] == 22) {
//        tallySrc[i - 1] = 3020;
//      }
      Serial << F("Tally ") << i << " -> " << tallySrc[i-1] << "\n";
    }

    // Initialize a connection to the switcher:
    AtemSwitcher.begin(IPAddress(atem_ip[0], atem_ip[1], atem_ip[2], atem_ip[3]), 56417);    // <= SETUP!
    // AtemSwitcher.serialOutput(true);
    AtemSwitcher.connect();

    // Set Bi-color LED orange - indicates "connecting...":
    digitalWrite(redLED,!true);
    digitalWrite(greenLED,!true);
    
    Serial.println("Work Mode");
  }
}

bool AtemOnline = false;
void loop() {
  if (isConfigMode)  {
    webserver.processConnection();
    digitalWrite(blueLED, (((unsigned long)millis() >> 3) & B11000000) ? !true : !false);
    if (millis() > 600000) {
      testRun();
    }
  }
  else {
    // Check for packets, respond to them etc. Keeping the connection alive!
    AtemSwitcher.runLoop();

    // If the switcher has been initialized, check for button presses as reflect status of switcher in button lights:
    if (AtemSwitcher.hasInitialized())  {
      if (!AtemOnline)  {
        AtemOnline = true;
        // Set Bi-color LED to red or green depending on mode:
        digitalWrite(redLED, !false);
        digitalWrite(greenLED, !true);
      }

      TallyLights();
    }
    // If connection is gone anyway, try to reconnect:
    else  {
      if (AtemOnline)  {
        AtemOnline = false;

        // Set Bi-color LED off = "no connection"
        digitalWrite(greenLED, !false);
        digitalWrite(redLED, !false);
      }

      Serial.println("Connection to ATEM Switcher has timed out - reconnecting!");

      // Set Bi-color LED orange - indicates "connecting...":
      digitalWrite(greenLED, !true);
      digitalWrite(redLED, !true);

      blinkTally();
    }
  }
}

void TallyLights()  {
  static uint8_t tallyMask1 = 0;
  static uint8_t tallyMask2 = 0;
  static uint8_t tallyMask_prev1 = 255;
  static uint8_t tallyMask_prev2 = 255;

  for (uint8_t i = 0; i < 4; i++)  {
    tallyMask1 = tallyMask1 << 2;
    if (tallySrc[i] - 1 < AtemSwitcher.getTallyByIndexSources())  {
      tallyMask1 |= AtemSwitcher.getTallyByIndexTallyFlags(tallySrc[i] - 1);
    }
  }

  if (tallyMask1 != tallyMask_prev1)  {
    tallyMask_prev1 = tallyMask1;
    Serial << F("Tally1 updated: ") << _BINPADL(tallyMask_prev1, 8, "0") << F("\n");

    for (uint8_t i = 0; i < 4; i++)  {
      GPIOboard.setOutput(1 + i * 2, tallyMask1 & (B1 << ((3 - i) * 2)));
      GPIOboard.setOutput(2 + i * 2, tallyMask1 & (B1 << ((3 - i) * 2)) ? LOW : tallyMask1 & (B10 << ((3 - i) * 2)));
    }
  }

  if (numberOfTallyLights>4) {
    for (uint8_t i = 0; i < 4; i++)  {
    tallyMask2 = tallyMask2 << 2;
    if (tallySrc[i+4] - 1 < AtemSwitcher.getTallyByIndexSources())  {
      tallyMask2 |= AtemSwitcher.getTallyByIndexTallyFlags(tallySrc[i+4] - 1);
    }
  }

  if (tallyMask2 != tallyMask_prev2)  {
    tallyMask_prev2 = tallyMask2;
    Serial << F("Tally2 updated: ") << _BINPADL(tallyMask_prev2, 8, "0") << F("\n");

    for (uint8_t i = 0; i < 4; i++)  {
      GPIOboard.setOutput(9 + i * 2, tallyMask2 & (B1 << ((3 - i) * 2)));
      GPIOboard.setOutput(10 + i * 2, tallyMask2 & (B1 << ((3 - i) * 2)) ? LOW : tallyMask2 & (B10 << ((3 - i) * 2)));
    }
  }
  }
}

void blinkTally () {
  for (uint8_t i = 0; i < numberOfTallyLights; i++)  {
    GPIOboard.setOutput(1 + i * 2, HIGH);
    GPIOboard.setOutput(2 + i * 2, LOW);
  }
  lDelay(200);
  for (uint8_t i = 0; i < numberOfTallyLights; i++)  {
    GPIOboard.setOutput(1 + i * 2, LOW);
    GPIOboard.setOutput(2 + i * 2, LOW);
  }
  lDelay(200);
}

/**
 * Local delay function
 */
void lDelay(unsigned long timeout)  {
  unsigned long thisTime = millis();
  do {
    AtemSwitcher.runLoop();
    Serial << F(".");
    static int k = 1;
    k++;
    if (k > 100) {
      k = 1;
      Serial << F("\n");
    }
  }
  while (!sTools.hasTimedOut(thisTime, timeout));
}


void testRun () {
  uint8_t randomTally = random(1, 2*numberOfTallyLights);
  uint16_t randomTime = random(500, 3000);
  GPIOboard.setOutput(randomTally, HIGH);
  delay(randomTime);
  GPIOboard.setOutput(randomTally, LOW);
}

